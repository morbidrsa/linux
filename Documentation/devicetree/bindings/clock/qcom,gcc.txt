## Documentation/devicetree/bindings/clock/qcom,gcc.txt
```
MSM Global Clock & Reset Controller Binding
-------------------------------------------

Required properties :
- compatible : shall contain at least "qcom,gcc" and only one of the
	       following:

			"qcom,gcc-8660"
			"qcom,gcc-8960"

- reg : shall contain base register location and length
- #clock-cells : shall contain 1
- #reset-cells : shall contain 1

Example:
	clock-controller@900000 {
		compatible = "qcom,gcc-8960", "qcom,gcc";
		reg = <0x900000 0x4000>;
		#clock-cells = <1>;
		#reset-cells = <1>;
	};
```

## Documentation/devicetree/bindings/clock/qcom,mmcc.txt
```
MSM Multimedia Clock Controller Binding
-----------------------------------------

Required properties :
- compatible : shall contain at least "qcom,mmcc" and only one of the
	       following:

			"qcom,mmcc-8660"
			"qcom,mmcc-8960"

- reg : shall contain base register location and length
- #clock-cells : shall contain 1
- #reset-cells : shall contain 1

Example:
	clock-controller@4000000 {
		compatible = "qcom,mmcc-8960", "qcom,mmcc";
		reg = <0x4000000 0x1000>;
		#clock-cells = <1>;
		#reset-cells = <1>;
	};
```

## drivers/clk/msm/Kconfig
```kconfig
config COMMON_CLK_MSM
	tristate "Support for Qualcomm's MSM designs"
	depends on OF
	select REGMAP_MMIO
```
